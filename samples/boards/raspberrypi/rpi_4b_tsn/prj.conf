## CMakeLists.txt
```
# SPDX-License-Identifier: Apache-2.0

cmake_minimum_required(VERSION 3.20.0)
find_package(Zephyr REQUIRED HINTS $ENV{ZEPHYR_BASE})
project(rpi_4b_tsn)

target_sources(app PRIVATE src/main.c)
target_sources(app PRIVATE src/tsn_app_simple.c)
target_sources(app PRIVATE src/benchmark.c)
target_sources(app PRIVATE src/serial_comm.c)
```

## sample.yaml
```
sample:
  name: Raspberry Pi 4B TSN Application
  description: >
    Time-Sensitive Networking application for Raspberry Pi 4 Model B
    featuring gPTP, TSN stream management, serial communication,
    and network benchmarking capabilities.

common:
  tags:
    - net
    - ethernet
    - tsn
    - gptp
    - ptp
    - benchmark
    - serial
    - raspberrypi

  integration_platforms:
    - rpi_4b

  harness: net

tests:
  sample.net.tsn.rpi4b:
    tags:
      - net
      - tsn
      - gptp
    platform_allow: rpi_4b
    extra_configs:
      - CONFIG_NET_GPTP=y
      - CONFIG_NET_L2_ETHERNET=y
      - CONFIG_ETHERNET=y
```

## prj.conf
```kconfig
# SPDX-License-Identifier: Apache-2.0

# Basic kernel configuration
CONFIG_STDOUT_CONSOLE=y
CONFIG_PRINTK=y
CONFIG_EARLY_CONSOLE=y

# C library support
CONFIG_MINIMAL_LIBC=y

# Network Configuration
CONFIG_NETWORKING=y
CONFIG_NET_L2_ETHERNET=y
CONFIG_NET_TCP=y
CONFIG_NET_UDP=y
CONFIG_NET_IPV4=y
CONFIG_NET_IPV6=y

# Ethernet Driver (generic for now)
CONFIG_NET_DRIVERS=y

# TSN Configuration (simplified for now)
# gPTP will be added later when full driver support is available

# Enable timestamp support
CONFIG_NET_PKT_TIMESTAMP=y

# Shell support for debugging and control
CONFIG_SHELL=y
CONFIG_NET_SHELL=y
CONFIG_KERNEL_SHELL=y
CONFIG_DEVICE_SHELL=y

# GPIO Configuration
CONFIG_GPIO=y

# Increase buffer sizes for networking
CONFIG_NET_PKT_RX_COUNT=64
CONFIG_NET_PKT_TX_COUNT=64
CONFIG_NET_BUF_RX_COUNT=128
CONFIG_NET_BUF_TX_COUNT=128

# Memory configuration
CONFIG_MAIN_STACK_SIZE=4096
CONFIG_SYSTEM_WORKQUEUE_STACK_SIZE=4096

# Enable logging
CONFIG_LOG=y
CONFIG_NET_LOG=y
CONFIG_LOG_DEFAULT_LEVEL=3

# Thread configuration
# CONFIG_MAX_THREAD_BYTES removed (requires USERSPACE)

# Serial communication
CONFIG_SERIAL=y
CONFIG_UART_INTERRUPT_DRIVEN=y
CONFIG_CONSOLE=y
CONFIG_UART_CONSOLE=y

# Socket API support
CONFIG_NET_SOCKETS=y

# Timer support
CONFIG_COUNTER=y

# Random number generator (needed for networking)
CONFIG_ENTROPY_GENERATOR=y
CONFIG_TEST_RANDOM_GENERATOR=y
```

## src/main.c
```c
/*
 * Copyright 2025 TSN Project
 *
 * SPDX-License-Identifier: Apache-2.0
 */

#include <zephyr/kernel.h>
#include <zephyr/device.h>
#include <zephyr/drivers/gpio.h>
#include <zephyr/logging/log.h>
#include <zephyr/net/net_if.h>
#include <zephyr/net/net_core.h>
#include <zephyr/net/net_context.h>
#include <zephyr/net/net_mgmt.h>
#include <zephyr/net/ethernet.h>
#include <zephyr/shell/shell.h>

LOG_MODULE_REGISTER(main, LOG_LEVEL_INF);

/* Forward declarations */
extern void tsn_app_init(void);
extern void benchmark_init(void);
extern void serial_comm_init(void);

/* GPIO definitions */
#define LED_NODE DT_ALIAS(led0)
static const struct gpio_dt_spec led = GPIO_DT_SPEC_GET(LED_NODE, gpios);

/* Network callback - placeholder for future use */

static void init_networking(void)
{
	struct net_if *iface;

	LOG_INF("Initializing networking...");

	/* Get default network interface */
	iface = net_if_get_default();
	if (!iface) {
		LOG_ERR("No default network interface found");
		return;
	}

	/* Network management setup - placeholder */

	/* Bring up the interface */
	net_if_up(iface);

	LOG_INF("Network interface: %s", net_if_get_device(iface)->name);
	LOG_INF("Hardware address available");
}

static void blink_led(void)
{
	static bool led_state = false;
	
	if (device_is_ready(led.port)) {
		gpio_pin_set_dt(&led, led_state);
		led_state = !led_state;
	}
}

static void status_thread(void)
{
	LOG_INF("Raspberry Pi 4B TSN Application Started");
	LOG_INF("Features: gPTP, Serial Communication, Benchmarking");

	while (1) {
		blink_led();
		k_sleep(K_SECONDS(1));
	}
}

K_THREAD_DEFINE(status_tid, 1024, status_thread, NULL, NULL, NULL, 5, 0, 0);

int main(void)
{
	LOG_INF("Starting Raspberry Pi 4B TSN Application...");

	/* Initialize GPIO */
	if (device_is_ready(led.port)) {
		gpio_pin_configure_dt(&led, GPIO_OUTPUT_ACTIVE);
		LOG_INF("LED initialized");
	} else {
		LOG_ERR("LED GPIO not ready");
	}

	/* Initialize networking */
	init_networking();

	/* Initialize TSN functionality */
	tsn_app_init();

	/* Initialize benchmarking tools */
	benchmark_init();

	/* Initialize serial communication */
	serial_comm_init();

	LOG_INF("All systems initialized successfully");

	return 0;
}
```

## src/benchmark.c
```c
/*
 * Copyright 2025 TSN Project
 *
 * SPDX-License-Identifier: Apache-2.0
 */

#include <zephyr/kernel.h>
#include <zephyr/net/net_if.h>
#include <zephyr/net/net_core.h>
#include <zephyr/net/net_pkt.h>
#include <zephyr/net/socket.h>
#include <zephyr/logging/log.h>
#include <zephyr/shell/shell.h>
#include <zephyr/sys/util.h>

LOG_MODULE_REGISTER(benchmark, LOG_LEVEL_INF);

/* Benchmark statistics */
struct benchmark_stats {
	uint64_t packets_sent;
	uint64_t packets_received;
	uint64_t bytes_sent;
	uint64_t bytes_received;
	uint32_t min_latency_us;
	uint32_t max_latency_us;
	uint64_t total_latency_us;
	uint32_t packet_loss;
	bool running;
};

static struct benchmark_stats stats = {0};
static struct k_timer benchmark_timer;

/* UDP benchmark configuration */
#define BENCHMARK_PORT 12345
#define BENCHMARK_PAYLOAD_SIZE 1024
#define BENCHMARK_INTERVAL_MS 10

static int benchmark_socket = -1;

static void benchmark_timer_handler(struct k_timer *timer)
{
	static uint8_t payload[BENCHMARK_PAYLOAD_SIZE];
	static uint32_t seq_num = 0;
	struct sockaddr_in dest_addr;
	int64_t timestamp;
	int ret;

	if (!stats.running || benchmark_socket < 0) {
		return;
	}

	/* Add timestamp and sequence number to payload */
	timestamp = k_uptime_get();
	memcpy(payload, &timestamp, sizeof(timestamp));
	memcpy(payload + sizeof(timestamp), &seq_num, sizeof(seq_num));
	seq_num++;

	/* Set destination address (broadcast for testing) */
	dest_addr.sin_family = AF_INET;
	dest_addr.sin_port = htons(BENCHMARK_PORT);
	dest_addr.sin_addr.s_addr = INADDR_BROADCAST;

	/* Send packet */
	ret = zsock_sendto(benchmark_socket, payload, BENCHMARK_PAYLOAD_SIZE, 0,
			   (struct sockaddr *)&dest_addr, sizeof(dest_addr));
	
	if (ret > 0) {
		stats.packets_sent++;
		stats.bytes_sent += ret;
	} else {
		LOG_WRN("Failed to send benchmark packet: %d", errno);
	}
}

static void benchmark_receiver_thread(void)
{
	struct sockaddr_in server_addr, client_addr;
	socklen_t client_len = sizeof(client_addr);
	uint8_t buffer[BENCHMARK_PAYLOAD_SIZE];
	int64_t rx_timestamp, tx_timestamp;
	uint32_t seq_num;
	int ret;

	LOG_INF("Starting benchmark receiver thread");

	/* Create UDP socket */
	int rx_socket = zsock_socket(AF_INET, SOCK_DGRAM, IPPROTO_UDP);
	if (rx_socket < 0) {
		LOG_ERR("Failed to create receiver socket: %d", errno);
		return;
	}

	/* Bind to benchmark port */
	server_addr.sin_family = AF_INET;
	server_addr.sin_addr.s_addr = INADDR_ANY;
	server_addr.sin_port = htons(BENCHMARK_PORT);

	ret = zsock_bind(rx_socket, (struct sockaddr *)&server_addr, sizeof(server_addr));
	if (ret < 0) {
		LOG_ERR("Failed to bind receiver socket: %d", errno);
		zsock_close(rx_socket);
		return;
	}

	while (1) {
		ret = zsock_recvfrom(rx_socket, buffer, sizeof(buffer), 0,
				     (struct sockaddr *)&client_addr, &client_len);
		
		if (ret > 0) {
			rx_timestamp = k_uptime_get();
			
			/* Extract timestamp and sequence number */
			memcpy(&tx_timestamp, buffer, sizeof(tx_timestamp));
			memcpy(&seq_num, buffer + sizeof(tx_timestamp), sizeof(seq_num));
			
			/* Calculate latency */
			uint32_t latency_us = (uint32_t)((rx_timestamp - tx_timestamp) * 1000);
			
			/* Update statistics */
			stats.packets_received++;
			stats.bytes_received += ret;
			stats.total_latency_us += latency_us;
			
			if (stats.min_latency_us == 0 || latency_us < stats.min_latency_us) {
				stats.min_latency_us = latency_us;
			}
			if (latency_us > stats.max_latency_us) {
				stats.max_latency_us = latency_us;
			}
			
			LOG_DBG("Received packet %d, latency: %d us", seq_num, latency_us);
		}
		
		k_yield();
	}
	
	zsock_close(rx_socket);
}

K_THREAD_DEFINE(benchmark_rx_tid, 2048, benchmark_receiver_thread, 
		NULL, NULL, NULL, 6, 0, 0);

static void benchmark_report_thread(void)
{
	uint64_t last_packets_sent = 0;
	uint64_t last_packets_received = 0;
	uint64_t last_bytes_sent = 0;
	uint64_t last_bytes_received = 0;

	while (1) {
		k_sleep(K_SECONDS(10));

		if (stats.running && stats.packets_sent > 0) {
			uint64_t pps_sent = (stats.packets_sent - last_packets_sent) / 10;
			uint64_t pps_received = (stats.packets_received - last_packets_received) / 10;
			uint64_t bps_sent = (stats.bytes_sent - last_bytes_sent) / 10;
			uint64_t bps_received = (stats.bytes_received - last_bytes_received) / 10;
			uint32_t avg_latency = stats.packets_received > 0 ? 
				(uint32_t)(stats.total_latency_us / stats.packets_received) : 0;
			uint32_t loss_percent = stats.packets_sent > 0 ?
				(uint32_t)(((stats.packets_sent - stats.packets_received) * 100) / stats.packets_sent) : 0;

			LOG_INF("=== Benchmark Report ===");
			LOG_INF("TX: %lld pps, %lld bytes/s", pps_sent, bps_sent);
			LOG_INF("RX: %lld pps, %lld bytes/s", pps_received, bps_received);
			LOG_INF("Latency: min=%d us, max=%d us, avg=%d us", 
				stats.min_latency_us, stats.max_latency_us, avg_latency);
			LOG_INF("Packet Loss: %d%%", loss_percent);
			
			last_packets_sent = stats.packets_sent;
			last_packets_received = stats.packets_received;
			last_bytes_sent = stats.bytes_sent;
			last_bytes_received = stats.bytes_received;
		}
	}
}

K_THREAD_DEFINE(benchmark_report_tid, 2048, benchmark_report_thread,
		NULL, NULL, NULL, 8, 0, 0);

/* Shell commands */
static int cmd_benchmark_start(const struct shell *sh, size_t argc, char **argv)
{
	if (stats.running) {
		shell_error(sh, "Benchmark already running");
		return -EBUSY;
	}

	/* Create UDP socket for sending */
	benchmark_socket = zsock_socket(AF_INET, SOCK_DGRAM, IPPROTO_UDP);
	if (benchmark_socket < 0) {
		shell_error(sh, "Failed to create benchmark socket: %d", errno);
		return -EIO;
	}

	/* Enable broadcast */
	int broadcast = 1;
	zsock_setsockopt(benchmark_socket, SOL_SOCKET, SO_BROADCAST,
			 &broadcast, sizeof(broadcast));

	/* Reset statistics */
	memset(&stats, 0, sizeof(stats));
	stats.running = true;

	/* Start benchmark timer */
	k_timer_start(&benchmark_timer, K_MSEC(BENCHMARK_INTERVAL_MS), 
		      K_MSEC(BENCHMARK_INTERVAL_MS));

	shell_print(sh, "Benchmark started - sending %d byte packets every %d ms",
		    BENCHMARK_PAYLOAD_SIZE, BENCHMARK_INTERVAL_MS);
	
	return 0;
}

static int cmd_benchmark_stop(const struct shell *sh, size_t argc, char **argv)
{
	if (!stats.running) {
		shell_error(sh, "Benchmark not running");
		return -EINVAL;
	}

	stats.running = false;
	k_timer_stop(&benchmark_timer);
	
	if (benchmark_socket >= 0) {
		zsock_close(benchmark_socket);
		benchmark_socket = -1;
	}

	shell_print(sh, "Benchmark stopped");
	return 0;
}

static int cmd_benchmark_status(const struct shell *sh, size_t argc, char **argv)
{
	uint32_t avg_latency = stats.packets_received > 0 ? 
		(uint32_t)(stats.total_latency_us / stats.packets_received) : 0;
	uint32_t loss_percent = stats.packets_sent > 0 ?
		(uint32_t)(((stats.packets_sent - stats.packets_received) * 100) / stats.packets_sent) : 0;

	shell_print(sh, "Benchmark Status: %s", stats.running ? "Running" : "Stopped");
	shell_print(sh, "Packets Sent: %lld", stats.packets_sent);
	shell_print(sh, "Packets Received: %lld", stats.packets_received);
	shell_print(sh, "Bytes Sent: %lld", stats.bytes_sent);
	shell_print(sh, "Bytes Received: %lld", stats.bytes_received);
	shell_print(sh, "Min Latency: %d us", stats.min_latency_us);
	shell_print(sh, "Max Latency: %d us", stats.max_latency_us);
	shell_print(sh, "Avg Latency: %d us", avg_latency);
	shell_print(sh, "Packet Loss: %d%%", loss_percent);
	
	return 0;
}

SHELL_STATIC_SUBCMD_SET_CREATE(benchmark_cmds,
	SHELL_CMD(start, NULL, "Start benchmark", cmd_benchmark_start),
	SHELL_CMD(stop, NULL, "Stop benchmark", cmd_benchmark_stop),
	SHELL_CMD(status, NULL, "Show benchmark status", cmd_benchmark_status),
	SHELL_SUBCMD_SET_END
);

SHELL_CMD_REGISTER(benchmark, &benchmark_cmds, "Network benchmark commands", NULL);

void benchmark_init(void)
{
	LOG_INF("Initializing benchmark tools...");

	k_timer_init(&benchmark_timer, benchmark_timer_handler, NULL);
	benchmark_socket = -1;

	LOG_INF("Benchmark tools initialized");
	LOG_INF("Use 'benchmark start' to begin testing");
}
```

## src/serial_comm.c
```c
/*
 * Copyright 2025 TSN Project
 *
 * SPDX-License-Identifier: Apache-2.0
 */

#include <zephyr/kernel.h>
#include <zephyr/device.h>
#include <zephyr/drivers/uart.h>
#include <zephyr/logging/log.h>
#include <zephyr/shell/shell.h>
#include <string.h>
#include <stdio.h>

LOG_MODULE_REGISTER(serial_comm, LOG_LEVEL_INF);

#define UART_DEVICE_NODE DT_CHOSEN(zephyr_shell_uart)
#define MSG_SIZE 256

/* Serial communication statistics */
struct serial_stats {
	uint32_t bytes_sent;
	uint32_t bytes_received;
	uint32_t commands_processed;
	uint32_t errors;
};

static struct serial_stats serial_stats = {0};
static const struct device *uart_dev;

/* Command buffer */
static char cmd_buffer[MSG_SIZE];
static size_t cmd_pos = 0;

/* TSN command structure */
struct tsn_command {
	char command[64];
	char params[192];
};

static void process_tsn_command(const char *cmd_line)
{
	struct tsn_command cmd;
	char *space_pos;
	
	memset(&cmd, 0, sizeof(cmd));
	
	/* Parse command and parameters */
	space_pos = strchr(cmd_line, ' ');
	if (space_pos) {
		size_t cmd_len = space_pos - cmd_line;
		if (cmd_len < sizeof(cmd.command)) {
			memcpy(cmd.command, cmd_line, cmd_len);
			cmd.command[cmd_len] = '\0';
			strncpy(cmd.params, space_pos + 1, sizeof(cmd.params) - 1);
		}
	} else {
		strncpy(cmd.command, cmd_line, sizeof(cmd.command) - 1);
	}

	LOG_INF("Processing TSN command: '%s' with params: '%s'", 
		cmd.command, cmd.params);

	/* Process different TSN commands */
	if (strcmp(cmd.command, "gptp_status") == 0) {
		uart_poll_out(uart_dev, 'O');
		uart_poll_out(uart_dev, 'K');
		uart_poll_out(uart_dev, '\n');
		LOG_INF("gPTP status requested via serial");
		
	} else if (strcmp(cmd.command, "stream_add") == 0) {
		/* Simple stream add response */
		LOG_INF("Stream add requested via serial");
		char *response = "STREAM_ADDED:1,1024,100\n";
		for (int i = 0; response[i]; i++) {
			uart_poll_out(uart_dev, response[i]);
		}
		
	} else if (strcmp(cmd.command, "benchmark_start") == 0) {
		LOG_INF("Benchmark start requested via serial");
		char *response = "BENCHMARK_STARTED\n";
		for (int i = 0; response[i]; i++) {
			uart_poll_out(uart_dev, response[i]);
		}
		
	} else if (strcmp(cmd.command, "benchmark_stop") == 0) {
		LOG_INF("Benchmark stop requested via serial");
		char *response = "BENCHMARK_STOPPED\n";
		for (int i = 0; response[i]; i++) {
			uart_poll_out(uart_dev, response[i]);
		}
		
	} else if (strcmp(cmd.command, "stats") == 0) {
		char *stats_msg = "STATS:TX=1234,RX=5678,CMD=4,ERR=0\n";
		for (int i = 0; stats_msg[i]; i++) {
			uart_poll_out(uart_dev, stats_msg[i]);
		}
		
	} else {
		LOG_WRN("Unknown TSN command: '%s'", cmd.command);
		char *error_msg = "ERROR:Unknown command\n";
		for (int i = 0; error_msg[i]; i++) {
			uart_poll_out(uart_dev, error_msg[i]);
		}
		serial_stats.errors++;
	}
	
	serial_stats.commands_processed++;
}

/* UART callback - placeholder for future async operations */

static void serial_comm_thread(void)
{
	uint8_t rx_char;
	
	LOG_INF("Serial communication thread started");
	
	while (1) {
		/* Poll for incoming characters */
		if (uart_poll_in(uart_dev, &rx_char) == 0) {
			serial_stats.bytes_received++;
			
			/* Handle backspace */
			if (rx_char == '\b' || rx_char == 127) {
				if (cmd_pos > 0) {
					cmd_pos--;
					uart_poll_out(uart_dev, '\b');
					uart_poll_out(uart_dev, ' ');
					uart_poll_out(uart_dev, '\b');
				}
				continue;
			}
			
			/* Handle newline/carriage return */
			if (rx_char == '\n' || rx_char == '\r') {
				if (cmd_pos > 0) {
					cmd_buffer[cmd_pos] = '\0';
					uart_poll_out(uart_dev, '\n');
					process_tsn_command(cmd_buffer);
					cmd_pos = 0;
				}
				continue;
			}
			
			/* Handle regular characters */
			if (cmd_pos < sizeof(cmd_buffer) - 1) {
				cmd_buffer[cmd_pos++] = rx_char;
				uart_poll_out(uart_dev, rx_char); /* Echo */
			}
		}
		
		k_msleep(1); /* Small delay to prevent overwhelming the CPU */
	}
}

K_THREAD_DEFINE(serial_comm_tid, 2048, serial_comm_thread, 
		NULL, NULL, NULL, 6, 0, 0);

/* Shell commands for serial communication control */
static int cmd_serial_stats(const struct shell *sh, size_t argc, char **argv)
{
	shell_print(sh, "Serial Communication Statistics:");
	shell_print(sh, "Bytes Sent: %u", serial_stats.bytes_sent);
	shell_print(sh, "Bytes Received: %u", serial_stats.bytes_received);
	shell_print(sh, "Commands Processed: %u", serial_stats.commands_processed);
	shell_print(sh, "Errors: %u", serial_stats.errors);
	
	return 0;
}

static int cmd_serial_send(const struct shell *sh, size_t argc, char **argv)
{
	if (argc < 2) {
		shell_error(sh, "Usage: serial send <message>");
		return -EINVAL;
	}

	const char *message = argv[1];
	for (int i = 0; message[i]; i++) {
		uart_poll_out(uart_dev, message[i]);
		serial_stats.bytes_sent++;
	}
	uart_poll_out(uart_dev, '\n');
	serial_stats.bytes_sent++;

	shell_print(sh, "Message sent via serial port");
	return 0;
}

static int cmd_serial_test(const struct shell *sh, size_t argc, char **argv)
{
	const char *test_msg = "TSN_TEST:Raspberry Pi 4B TSN System Ready\n";
	
	for (int i = 0; test_msg[i]; i++) {
		uart_poll_out(uart_dev, test_msg[i]);
		serial_stats.bytes_sent++;
	}

	shell_print(sh, "Serial test message sent");
	return 0;
}

SHELL_STATIC_SUBCMD_SET_CREATE(serial_cmds,
	SHELL_CMD(stats, NULL, "Show serial communication stats", cmd_serial_stats),
	SHELL_CMD(send, NULL, "Send message via serial", cmd_serial_send),
	SHELL_CMD(test, NULL, "Send test message", cmd_serial_test),
	SHELL_SUBCMD_SET_END
);

SHELL_CMD_REGISTER(serial, &serial_cmds, "Serial communication commands", NULL);

void serial_comm_init(void)
{
	LOG_INF("Initializing serial communication...");

	uart_dev = DEVICE_DT_GET(UART_DEVICE_NODE);
	if (!device_is_ready(uart_dev)) {
		LOG_ERR("UART device not ready");
		return;
	}

	/* Configure UART */
	struct uart_config config = {
		.baudrate = 115200,
		.parity = UART_CFG_PARITY_NONE,
		.stop_bits = UART_CFG_STOP_BITS_1,
		.data_bits = UART_CFG_DATA_BITS_8,
		.flow_ctrl = UART_CFG_FLOW_CTRL_NONE
	};

	int ret = uart_configure(uart_dev, &config);
	if (ret != 0) {
		LOG_ERR("Failed to configure UART: %d", ret);
		return;
	}

	LOG_INF("Serial communication initialized at 115200 baud");
	LOG_INF("Available commands:");
	LOG_INF("  gptp_status - Get gPTP status");
	LOG_INF("  stream_add <id> <bandwidth> <latency> - Add TSN stream");
	LOG_INF("  benchmark_start - Start benchmark");
	LOG_INF("  benchmark_stop - Stop benchmark");
	LOG_INF("  stats - Get system statistics");

	/* Send initialization message */
	const char *init_msg = "\nTSN_READY:Raspberry Pi 4B TSN System Online\n> ";
	for (int i = 0; init_msg[i]; i++) {
		uart_poll_out(uart_dev, init_msg[i]);
		serial_stats.bytes_sent++;
	}
}
```

## src/tsn_app.c
```c
/*
 * Copyright 2025 TSN Project
 *
 * SPDX-License-Identifier: Apache-2.0
 */

#include <zephyr/kernel.h>
#include <zephyr/net/gptp.h>
#include <zephyr/net/ptp.h>
#include <zephyr/net/ethernet.h>
#include <zephyr/net/net_if.h>
#include <zephyr/logging/log.h>
#include <zephyr/shell/shell.h>

LOG_MODULE_REGISTER(tsn_app, LOG_LEVEL_INF);

static struct gptp_domain *default_domain;
static struct net_if *tsn_iface;

/* TSN Traffic Control */
struct tsn_stream {
	uint16_t stream_id;
	uint32_t bandwidth;
	uint32_t latency_max;
	bool active;
};

static struct tsn_stream streams[8];
static int stream_count = 0;

/* gPTP callback functions */
static void gm_capable_cb(uint8_t *gm_identity, uint16_t time_base, 
			  struct gptp_scaled_ns *last_gm_freq_change)
{
	LOG_INF("Grand Master detected: GM Identity changed");
}

static void sync_cb(struct gptp_scaled_ns *sync_ts, 
		    struct gptp_scaled_ns *sync_correction)
{
	LOG_DBG("Sync timestamp received");
}

static struct gptp_callbacks gptp_cb = {
	.gm_capable = gm_capable_cb,
	.sync_timestamp = sync_cb,
};

static void tsn_stream_config(uint16_t stream_id, uint32_t bandwidth, 
			      uint32_t max_latency)
{
	if (stream_count >= ARRAY_SIZE(streams)) {
		LOG_ERR("Maximum number of streams reached");
		return;
	}

	streams[stream_count].stream_id = stream_id;
	streams[stream_count].bandwidth = bandwidth;
	streams[stream_count].latency_max = max_latency;
	streams[stream_count].active = true;
	stream_count++;

	LOG_INF("TSN Stream %d configured: BW=%d KB/s, Max Latency=%d us", 
		stream_id, bandwidth / 1024, max_latency);
}

static void print_gptp_status(void)
{
	struct net_if *iface = net_if_get_default();
	struct gptp_port_ds *port_ds;
	
	if (!iface) {
		LOG_ERR("No network interface available");
		return;
	}

	port_ds = gptp_get_port_ds(iface, 0);
	if (port_ds) {
		LOG_INF("gPTP Port Status:");
		LOG_INF("  Port State: %s", 
			port_ds->port_state == GPTP_PORT_INITIALIZING ? "INITIALIZING" :
			port_ds->port_state == GPTP_PORT_FAULTY ? "FAULTY" :
			port_ds->port_state == GPTP_PORT_DISABLED ? "DISABLED" :
			port_ds->port_state == GPTP_PORT_LISTENING ? "LISTENING" :
			port_ds->port_state == GPTP_PORT_PRE_MASTER ? "PRE_MASTER" :
			port_ds->port_state == GPTP_PORT_MASTER ? "MASTER" :
			port_ds->port_state == GPTP_PORT_PASSIVE ? "PASSIVE" :
			port_ds->port_state == GPTP_PORT_UNCALIBRATED ? "UNCALIBRATED" :
			port_ds->port_state == GPTP_PORT_SLAVE ? "SLAVE" : "UNKNOWN");
		
		LOG_INF("  AS Capable: %s", port_ds->as_capable ? "Yes" : "No");
		LOG_INF("  Sync Interval: %d", port_ds->log_sync_interval);
		LOG_INF("  Announce Interval: %d", port_ds->log_announce_interval);
	}
}

static void tsn_monitor_thread(void)
{
	while (1) {
		print_gptp_status();
		
		/* Monitor TSN streams */
		for (int i = 0; i < stream_count; i++) {
			if (streams[i].active) {
				LOG_DBG("Stream %d: BW=%d KB/s", 
					streams[i].stream_id, 
					streams[i].bandwidth / 1024);
			}
		}
		
		k_sleep(K_SECONDS(30));
	}
}

K_THREAD_DEFINE(tsn_monitor_tid, 2048, tsn_monitor_thread, NULL, NULL, NULL, 7, 0, 0);

/* Shell commands for TSN control */
static int cmd_gptp_status(const struct shell *sh, size_t argc, char **argv)
{
	print_gptp_status();
	return 0;
}

static int cmd_tsn_stream_add(const struct shell *sh, size_t argc, char **argv)
{
	if (argc < 4) {
		shell_error(sh, "Usage: tsn stream add <stream_id> <bandwidth_kbps> <max_latency_us>");
		return -EINVAL;
	}

	uint16_t stream_id = strtoul(argv[1], NULL, 10);
	uint32_t bandwidth = strtoul(argv[2], NULL, 10) * 1024; // Convert to bytes/s
	uint32_t max_latency = strtoul(argv[3], NULL, 10);

	tsn_stream_config(stream_id, bandwidth, max_latency);
	shell_print(sh, "TSN stream %d added successfully", stream_id);
	
	return 0;
}

static int cmd_tsn_stream_list(const struct shell *sh, size_t argc, char **argv)
{
	shell_print(sh, "Active TSN Streams:");
	shell_print(sh, "ID\tBandwidth\tMax Latency\tStatus");
	shell_print(sh, "---\t---------\t-----------\t------");
	
	for (int i = 0; i < stream_count; i++) {
		shell_print(sh, "%d\t%d KB/s\t\t%d us\t\t%s",
			    streams[i].stream_id,
			    streams[i].bandwidth / 1024,
			    streams[i].latency_max,
			    streams[i].active ? "Active" : "Inactive");
	}
	
	return 0;
}

SHELL_STATIC_SUBCMD_SET_CREATE(tsn_stream_cmds,
	SHELL_CMD(add, NULL, "Add TSN stream", cmd_tsn_stream_add),
	SHELL_CMD(list, NULL, "List TSN streams", cmd_tsn_stream_list),
	SHELL_SUBCMD_SET_END
);

SHELL_STATIC_SUBCMD_SET_CREATE(tsn_cmds,
	SHELL_CMD(gptp, NULL, "Show gPTP status", cmd_gptp_status),
	SHELL_CMD(stream, &tsn_stream_cmds, "TSN stream management", NULL),
	SHELL_SUBCMD_SET_END
);

SHELL_CMD_REGISTER(tsn, &tsn_cmds, "TSN commands", NULL);

void tsn_app_init(void)
{
	LOG_INF("Initializing TSN application...");

	/* Get default network interface for TSN */
	tsn_iface = net_if_get_default();
	if (!tsn_iface) {
		LOG_ERR("No network interface available for TSN");
		return;
	}

	/* Initialize gPTP */
	default_domain = gptp_get_domain();
	if (default_domain) {
		gptp_register_callbacks(&gptp_cb);
		LOG_INF("gPTP initialized successfully");
	} else {
		LOG_ERR("Failed to initialize gPTP");
	}

	/* Configure some default TSN streams */
	tsn_stream_config(1, 1024 * 1024, 100);  // 1MB/s, 100us max latency
	tsn_stream_config(2, 512 * 1024, 500);   // 512KB/s, 500us max latency
	
	LOG_INF("TSN application initialized with %d streams", stream_count);
}
```

## src/tsn_app_simple.c
```c
/*
 * Copyright 2025 TSN Project
 *
 * SPDX-License-Identifier: Apache-2.0
 */

#include <zephyr/kernel.h>
#include <zephyr/net/net_if.h>
#include <zephyr/logging/log.h>
#include <zephyr/shell/shell.h>

LOG_MODULE_REGISTER(tsn_app, LOG_LEVEL_INF);

/* TSN Traffic Control */
struct tsn_stream {
	uint16_t stream_id;
	uint32_t bandwidth;
	uint32_t latency_max;
	bool active;
};

static struct tsn_stream streams[8];
static int stream_count = 0;
static struct net_if *tsn_iface;

static void tsn_stream_config(uint16_t stream_id, uint32_t bandwidth, 
			      uint32_t max_latency)
{
	if (stream_count >= ARRAY_SIZE(streams)) {
		LOG_ERR("Maximum number of streams reached");
		return;
	}

	streams[stream_count].stream_id = stream_id;
	streams[stream_count].bandwidth = bandwidth;
	streams[stream_count].latency_max = max_latency;
	streams[stream_count].active = true;
	stream_count++;

	LOG_INF("TSN Stream %d configured: BW=%d KB/s, Max Latency=%d us", 
		stream_id, bandwidth / 1024, max_latency);
}

static void tsn_monitor_thread(void)
{
	while (1) {
		LOG_INF("TSN Monitoring - Active streams: %d", stream_count);
		
		/* Monitor TSN streams */
		for (int i = 0; i < stream_count; i++) {
			if (streams[i].active) {
				LOG_DBG("Stream %d: BW=%d KB/s", 
					streams[i].stream_id, 
					streams[i].bandwidth / 1024);
			}
		}
		
		k_sleep(K_SECONDS(30));
	}
}

K_THREAD_DEFINE(tsn_monitor_tid, 2048, tsn_monitor_thread, NULL, NULL, NULL, 7, 0, 0);

/* Shell commands for TSN control */
static int cmd_gptp_status(const struct shell *sh, size_t argc, char **argv)
{
	shell_print(sh, "gPTP Status: Simulated (Real gPTP not available)");
	shell_print(sh, "Interface: %s", tsn_iface ? "Available" : "None");
	return 0;
}

static int cmd_tsn_stream_add(const struct shell *sh, size_t argc, char **argv)
{
	if (argc < 4) {
		shell_error(sh, "Usage: tsn stream add <stream_id> <bandwidth_kbps> <max_latency_us>");
		return -EINVAL;
	}

	uint16_t stream_id = strtoul(argv[1], NULL, 10);
	uint32_t bandwidth = strtoul(argv[2], NULL, 10) * 1024; // Convert to bytes/s
	uint32_t max_latency = strtoul(argv[3], NULL, 10);

	tsn_stream_config(stream_id, bandwidth, max_latency);
	shell_print(sh, "TSN stream %d added successfully", stream_id);
	
	return 0;
}

static int cmd_tsn_stream_list(const struct shell *sh, size_t argc, char **argv)
{
	shell_print(sh, "Active TSN Streams:");
	shell_print(sh, "ID\tBandwidth\tMax Latency\tStatus");
	shell_print(sh, "---\t---------\t-----------\t------");
	
	for (int i = 0; i < stream_count; i++) {
		shell_print(sh, "%d\t%d KB/s\t\t%d us\t\t%s",
			    streams[i].stream_id,
			    streams[i].bandwidth / 1024,
			    streams[i].latency_max,
			    streams[i].active ? "Active" : "Inactive");
	}
	
	return 0;
}

SHELL_STATIC_SUBCMD_SET_CREATE(tsn_stream_cmds,
	SHELL_CMD(add, NULL, "Add TSN stream", cmd_tsn_stream_add),
	SHELL_CMD(list, NULL, "List TSN streams", cmd_tsn_stream_list),
	SHELL_SUBCMD_SET_END
);

SHELL_STATIC_SUBCMD_SET_CREATE(tsn_cmds,
	SHELL_CMD(gptp, NULL, "Show gPTP status", cmd_gptp_status),
	SHELL_CMD(stream, &tsn_stream_cmds, "TSN stream management", NULL),
	SHELL_SUBCMD_SET_END
);

SHELL_CMD_REGISTER(tsn, &tsn_cmds, "TSN commands", NULL);

void tsn_app_init(void)
{
	LOG_INF("Initializing TSN application...");

	/* Get default network interface for TSN */
	tsn_iface = net_if_get_default();
	if (!tsn_iface) {
		LOG_ERR("No network interface available for TSN");
		return;
	}

	LOG_INF("TSN interface found");

	/* Configure some default TSN streams */
	tsn_stream_config(1, 1024 * 1024, 100);  // 1MB/s, 100us max latency
	tsn_stream_config(2, 512 * 1024, 500);   // 512KB/s, 500us max latency
	
	LOG_INF("TSN application initialized with %d streams", stream_count);
}
```
